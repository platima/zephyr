## boards/waveshare/esp32s3_eth/Kconfig.esp32s3_eth
```kconfig
# ESP32-S3-ETH board configuration

# Copyright (c) 2025 Platima
# SPDX-License-Identifier: Apache-2.0

config BOARD_ESP32S3_ETH
	select SOC_ESP32S3_R8
	select SOC_ESP32S3_ETH_PROCPU if BOARD_ESP32S3_ETH_PROCPU
	select SOC_ESP32S3_ETH_APPCPU if BOARD_ESP32S3_ETH_APPCPU
```
